## blinky/main/Kconfig.projbuild
```kconfig
menu "Blinky Example Configuration"

    orsource "$IDF_PATH/examples/common_components/env_caps/$IDF_TARGET/Kconfig.env_caps"

    config GPIO_LED
        int "The blinky LED GPIO output pin"
        range ENV_GPIO_RANGE_MIN ENV_GPIO_OUT_RANGE_MAX
        default 8
        help
            The GPIO pin numbder assigned to a LED.

    config BLINK_PERIOD
        int "Blink period in msec"
        range 10 3600000
        default 1000
        help
            Define the blinking period in milliseconds.

endmenu
```

## components/Grove-LCD-RGB/Kconfig.projbuild
```kconfig
menu "I2C Configuration"

    orsource "$IDF_PATH/examples/common_components/env_caps/$IDF_TARGET/Kconfig.env_caps"

    config GPIO_I2C_SCL
        int "The I2C SCL GPIO output pin"
        range ENV_GPIO_RANGE_MIN ENV_GPIO_OUT_RANGE_MAX
        default 9
        help
            The GPIO pin number assigned to the I2C SCL line.

    config GPIO_I2C_SDA
        int "The I2C SDA GPIO output pin"
        range ENV_GPIO_RANGE_MIN ENV_GPIO_OUT_RANGE_MAX
        default 8
        help
            The GPIO pin number assigned to the I2C SDA line.

    config I2C_ADDR_LCD
        hex "The I2C address of the LCD"
        default 0x3E
        help
            The I2C address assigned to the LCD display.

    config I2C_ADDR_RGB
        hex "The I2C address of the RGB backlight"
        default 0x62
        help
            The I2C address assigned to the RGB backlight.

endmenu
```

## diag/main/Kconfig.projbuild
```kconfig
menu "Command Line Example Configuration"

    orsource "$IDF_PATH/examples/common_components/env_caps/$IDF_TARGET/Kconfig.env_caps"

    config UART_QUEUE_SIZE
        int "UART event queue size"
        default 10
        help
            The size of the UART event queue to handle events from the UART driver.

endmenu
```
